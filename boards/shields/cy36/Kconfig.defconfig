## boards/shields/cy36/Kconfig.defconfig
```kconfig
if SHIELD_CY36_LEFT

config ZMK_KEYBOARD_NAME
    default "cy36"

config ZMK_SPLIT_ROLE_CENTRAL
    default y

endif # SHIELD_CY36_LEFT

if SHIELD_CY36_LEFT || SHIELD_CY36_RIGHT

config ZMK_SPLIT
    default y

endif # SHIELD_CY36_LEFT || SHIELD_CY36_RIGHT
```

## boards/shields/cy36/Kconfig.shield
```kconfig
config SHIELD_CY36_LEFT
    def_bool $(shields_list_contains,cy36_left)

config SHIELD_CY36_RIGHT
    def_bool $(shields_list_contains,cy36_right)
```
